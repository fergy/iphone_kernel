## drivers/iio/accel/Kconfig
```kconfig
#
# Accelerometer drivers
#
menu "Accelerometers"

config HID_SENSOR_ACCEL_3D
	depends on HID_SENSOR_HUB
	select IIO_BUFFER
	select IIO_TRIGGERED_BUFFER
	select HID_SENSOR_IIO_COMMON
	select HID_SENSOR_IIO_TRIGGER
	tristate "HID Accelerometers 3D"
	help
	  Say yes here to build support for the HID SENSOR
	  accelerometers 3D.

config LIS331DLH_SPI
	tristate "ST Microelectronics LIS331DLH Accelerometer Driver (SPI)"
	depends on SPI
	select IIO_TRIGGERED_BUFFER if IIO_BUFFER
	help
	  Say yes here to build SPI support for the ST microelectronics
	  LIS331DLH 3-axis accelerometer.

config LIS331DLH_I2C
	tristate "ST Microelectronics LIS331DLH Accelerometer Driver (I2C)"
	depends on I2C
	select IIO_TRIGGERED_BUFFER if IIO_BUFFER
	help
	  Say yes here to build I2C support for the ST microelectronics
	  LIS331DLH 3-axis accelerometer.

endmenu
```

## drivers/misc/radio_ctrl/Kconfig
```kconfig
config RADIO_CTRL_CLASS
	bool "Radio Modem Controller Class"
	depends on IPHONE4S
	default y if IPHONE4S

config MDM6610_CTRL
	bool "iPhone 4S MDM6610 Modem Controller"
	depends on RADIO_CTRL_CLASS && IPHONE_4S
	default n
	select RADIO_CTRL_CLASS
	---help---
	  Enables the device driver to control and interface with
	  the modem co-processor.  This module is needed to monitor
	  modem panics, interact with the modem during factory resets,
	  and allow modem power up/down support.

	  If unsure, say N.
```
